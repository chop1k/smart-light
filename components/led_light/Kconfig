## components/led_light/Kconfig
```kconfig
menu "LED Light Module Configuration"

    config LED_LIGHT_ENABLE_TIME
        int "LED Light Enable Delay (milliseconds)"
        default 100
        range 0 10000
        help
            Delay time in milliseconds before the LED light is enabled.
            This allows time for hardware initialization and settling.
            Valid range: 0 - 10000 ms

    config LED_LIGHT_DISABLE_TIME
        int "LED Light Disable Delay (milliseconds)"
        default 100
        range 0 10000
        help
            Delay time in milliseconds before the LED light is disabled.
            This allows for graceful shutdown of the LED.
            Valid range: 0 - 10000 ms

    config LED_LIGHT_COLOR_RED
        int "LED Light Red Channel Intensity (0-255)"
        default 255
        range 0 255
        help
            Red channel intensity value for LED light color.
            Valid range: 0 (off) - 255 (maximum intensity)

    config LED_LIGHT_COLOR_GREEN
        int "LED Light Green Channel Intensity (0-255)"
        default 0
        range 0 255
        help
            Green channel intensity value for LED light color.
            Valid range: 0 (off) - 255 (maximum intensity)

    config LED_LIGHT_COLOR_BLUE
        int "LED Light Blue Channel Intensity (0-255)"
        default 0
        range 0 255
        help
            Blue channel intensity value for LED light color.
            Valid range: 0 (off) - 255 (maximum intensity)

    config LED_LIGHT_BRIGHTNESS
        int "LED Light brightness (0-100)""
        default 100
        range 0 100
        help
            Light brightness in percentage implemented by using PWM.
            Valid range: 0 (light disabled) - 100 (maximum brightness)

endmenu
```

## components/rgb_light/Kconfig
```kconfig
menu "RGB Light Module Configuration"

    config RGB_LIGHT_ENABLE_TIME
        int "RGB Light Enable Delay (milliseconds)"
        default 150
        range 0 10000
        help
            Delay time in milliseconds before the RGB light is enabled.
            This allows time for hardware initialization and settling.
            Valid range: 0 - 10000 ms

    config RGB_LIGHT_DISABLE_TIME
        int "RGB Light Disable Delay (milliseconds)"
        default 150
        range 0 10000
        help
            Delay time in milliseconds before the RGB light is disabled.
            This allows for graceful shutdown of the RGB light.
            Valid range: 0 - 10000 ms

    config RGB_LIGHT_COLOR_RED
        int "RGB Light Red Channel Intensity (0-255)"
        default 255
        range 0 255
        help
            Red channel intensity value for RGB light color.
            Valid range: 0 (off) - 255 (maximum intensity)

    config RGB_LIGHT_COLOR_GREEN
        int "RGB Light Green Channel Intensity (0-255)"
        default 255
        range 0 255
        help
            Green channel intensity value for RGB light color.
            Valid range: 0 (off) - 255 (maximum intensity)

    config RGB_LIGHT_COLOR_BLUE
        int "RGB Light Blue Channel Intensity (0-255)"
        default 255
        range 0 255
        help
            Blue channel intensity value for RGB light color.
            Valid range: 0 (off) - 255 (maximum intensity)

endmenu
```

## main/Kconfig.projbuild
```kconfig
menu "Main Application Configuration"

    config ENABLE_LED_LIGHT
        bool "Enable LED Light Module"
        default y
        help
            Enable or disable the LED light module.
            When enabled, LED light functionality will be available.
            When disabled, LED light module will not be compiled.

    config ENABLE_RGB_LIGHT
        bool "Enable RGB Light Module"
        default y
        help
            Enable or disable the RGB light module.
            When enabled, RGB light functionality will be available.
            When disabled, RGB light module will not be compiled.

endmenu
```
